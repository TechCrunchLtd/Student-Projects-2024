// #define SSD1306

#include "patient_config.h"
#include <Adafruit_GFX.h>
#include <Adafruit_ST7789.h> // Hardware-specific library for ST7789
#include <SPI.h>


#define TFT_CS        		  2
#define TFT_DC        		  0
#define TFT_RST       		 16
#define SCREEN_INTERVAL     100    // screen will be on for these seconds

Adafruit_ST7789 tft = Adafruit_ST7789(TFT_CS, TFT_DC, TFT_RST);

DEVICE_PARAMS displayed_params;
unsigned long disp_millis;

const unsigned char logo_white [] PROGMEM = {
	// 'logo_white, 236x240px
	0x00, 0x00, 0x00, 0x00, 0x00, 0x00, 0x00, 0x00, 0x00, 0x00, 0x00, 0x00, 0x00, 0x00, 0x00, 0x00, 
	0x00, 0x00, 0x00, 0x00, 0x00, 0x00, 0x00, 0x00, 0x00, 0x00, 0x00, 0x00, 0x00, 0x00, 0x00, 0x00, 
	0x00, 0x00, 0x00, 0x00, 0x00, 0x00, 0x00, 0x00, 0x00, 0x00, 0x00, 0x00, 0x00, 0x00, 0x00, 0x00, 
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	0x00, 0x00, 0x00, 0x00, 0x00, 0x00, 0x00, 0x00, 0x00, 0x00, 0x00, 0x00, 0x00, 0x00, 0x00, 0x00
};

const unsigned char pulse_icon [] PROGMEM = {
	// 'pulse, 95x95px
	0x00, 0x00, 0x00, 0x00, 0x00, 0x00, 0x00, 0x00, 0x00, 0x00, 0x00, 0x00, 0x00, 0x00, 0x00, 0x00, 
	0x00, 0x00, 0x00, 0x00, 0x00, 0x00, 0x00, 0x00, 0x00, 0x00, 0x00, 0x00, 0x00, 0x00, 0x00, 0x00, 
	0x00, 0x00, 0x00, 0x00, 0x00, 0x00, 0x00, 0x00, 0x00, 0x00, 0x00, 0x00, 0x00, 0x00, 0x00, 0x00, 
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	0x00, 0x00, 0x00, 0x00
};

const unsigned char spo2_icon [] PROGMEM = {
	// 'Spo2, 95x95px
	0x00, 0x00, 0x00, 0x00, 0x00, 0x00, 0x00, 0x00, 0x00, 0x00, 0x00, 0x00, 0x00, 0x00, 0x00, 0x00, 
	0x00, 0x00, 0x00, 0x00, 0x00, 0x00, 0x00, 0x00, 0x00, 0x00, 0x00, 0x00, 0x00, 0x00, 0x00, 0x00, 
	0x00, 0x00, 0x00, 0x00, 0x00, 0x00, 0x00, 0x00, 0x00, 0x06, 0x00, 0x00, 0x00, 0x00, 0x00, 0x00, 
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	0x00, 0x00, 0x00, 0x00
};

const unsigned char temp_icon [] PROGMEM = {
	// 'Temp, 95x95px
	0x00, 0x00, 0x00, 0x00, 0x00, 0x00, 0x00, 0x00, 0x00, 0x00, 0x00, 0x00, 0x00, 0x00, 0x00, 0x00, 
	0x00, 0x00, 0x00, 0x00, 0x00, 0x00, 0x00, 0x00, 0x00, 0x00, 0x00, 0x00, 0x00, 0x00, 0x00, 0x00, 
	0x00, 0x00, 0x00, 0x00, 0x00, 0x00, 0x00, 0x00, 0x00, 0x00, 0x00, 0x00, 0x00, 0x00, 0x00, 0x00, 
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	0x00, 0x00, 0x00, 0x00
};


bool device_displayInit( void )
{
    tft.init(240, 320);           // Init ST7789 320x240

    #ifdef DEVICE_DEBUG
        Serial.println("display init");
    #endif

	tft.setRotation(1);
	tft.fillScreen(ST77XX_BLACK);
	delay(500);

	tft.drawBitmap(42,0, logo_white, 236, 240, ST77XX_YELLOW);
	delay(3000);

	displayStart();
    
    return true;
}

void displayStart( void )
{
    tft.fillScreen(ST77XX_BLACK);
	tft.drawRect(0, 0, tft.width()/3, tft.height()*4/5, ST77XX_WHITE);
	tft.drawRect(tft.width()/3, 0, tft.width()*2/3, tft.height()*4/5, ST77XX_WHITE);
	tft.drawRect(tft.width()*2/3, 0, tft.width(), tft.height()*4/5, ST77XX_WHITE);
	
	uint8_t x = 3;
	uint8_t y = 30;
	tft.drawBitmap(x,x, temp_icon, 95, 95, ST77XX_GREEN);
	tft.setCursor(x, tft.height()/2);
	tft.setTextColor(ST77XX_GREEN);
	tft.setTextSize(4);
	tft.print(" 37");
	tft.setTextSize(2);
	tft.print("o");
	tft.setCursor(x, tft.height()/2 + y);
	tft.print("  celc");

	tft.drawBitmap(tft.width()/3 + x, x, pulse_icon, 95, 95, ST77XX_MAGENTA);
	tft.setCursor(tft.width()/3 + x, tft.height()/2);
	tft.setTextColor(ST77XX_MAGENTA);
	tft.setTextSize(4);
	tft.print(" 72");
	tft.setTextSize(2);
	tft.print("p");
	tft.setCursor(tft.width()/3 + x, tft.height()/2 + y);
	tft.setTextSize(2);
	tft.print("  bpm");

	tft.drawBitmap(tft.width()*2/3 + x, x, spo2_icon, 95, 95, ST77XX_BLUE);
	tft.setCursor(tft.width()*2/3 + x, tft.height()/2);
	tft.setTextColor(ST77XX_BLUE);
	tft.setTextSize(4);
	tft.print(" 85");
	tft.setTextSize(2);
	tft.print("%");
	tft.setCursor(tft.width()*2/3 + x, tft.height()/2 + y);
	tft.print("  perc");
}

void displayParameter(uint8_t val, uint16_t start_width, uint16_t color)
{
	char buf[5];

	tft.fillRect(start_width, tft.height()/2, 70, 28, ST77XX_BLACK);
	tft.setCursor(start_width, tft.height()/2);
	tft.setTextSize(4);
	tft.setTextColor(color);
	if(val<100)
		sprintf(buf, " %2d", val);
	else
		sprintf(buf, "%2d", val);
	tft.print(buf);

}

void device_displayUpdate( void )
{
	#ifdef DEVICE_DEBUG
		Serial.println(device_params.device_id);
		Serial.println(device_params.wifi_name);
		Serial.println(device_params.current_date);
		Serial.println(device_params.current_time);
		Serial.println(device_params.local_server);
		Serial.println(device_params.server_running);
		Serial.println(device_params.updates_enabled);
		Serial.println(device_params.update_interval);
		Serial.println(device_params.temperature);
		Serial.println(device_params.oxygen_level);
		Serial.println(device_params.heart_rate);
	#endif

	uint8_t x = 3;
	char buf[DEVICE_MAX_STR_LEN];

	//temp
	if(displayed_params.temperature != device_params.temperature)
	{
		displayParameter(device_params.temperature, x, ST77XX_GREEN);
		displayed_params.temperature = device_params.temperature;
	}

	//pulse
	if(displayed_params.heart_rate != device_params.heart_rate)
	{
		displayParameter(device_params.heart_rate, tft.width()/3+x, ST77XX_MAGENTA);
		displayed_params.heart_rate = device_params.heart_rate;
	}
	
	//spo2
	if(displayed_params.oxygen_level != device_params.oxygen_level)
	{
		displayParameter(device_params.oxygen_level, tft.width()*2/3+x, ST77XX_BLUE);
		displayed_params.oxygen_level = device_params.oxygen_level;
	}
	
	//date
	if(strcmp(displayed_params.current_date, device_params.current_date) != 0)
	{
		tft.fillRect(0, tft.height()*4/5 + x, tft.width()*8/12, tft.height()*1/10, ST77XX_BLACK);
		tft.setCursor(x, tft.height()*4/5 + x+x);
		tft.setTextColor(ST77XX_WHITE);
		tft.setTextSize(2);
		tft.print(device_params.current_date);
		sprintf(displayed_params.current_date, "%s",device_params.current_date);
	}

	//time
	if(strcmp(displayed_params.current_time, device_params.current_time) != 0)
	{
		tft.fillRect(tft.width()*8/12, tft.height()*4/5 + x, tft.width()*4/12, tft.height()*1/10, ST77XX_BLACK);
		tft.setCursor(tft.width()*8/12, tft.height()*4/5 + x+x);
		tft.setTextColor(ST77XX_WHITE);
		tft.setTextSize(2);
		tft.println(device_params.current_time);
		sprintf(displayed_params.current_time, "%s",device_params.current_time);
	}

	//message
	if(device_params.device_error == NO_ERROR)
	{
		if(device_params.server_running){
			sprintf(device_params.error_message, "IP: %s", device_params.local_server);
		}
		else{
			sprintf(device_params.error_message, "Local server is off");
		}
	}
	if(strcmp(displayed_params.error_message, device_params.error_message) != 0)
	{
		tft.fillRect(0, tft.height()*4/5 + 24+x, tft.width(), tft.height()*1/10, ST77XX_BLACK);
		tft.setCursor(x, tft.height()*4/5 + 24+x);
		tft.setTextColor(ST77XX_WHITE);
		tft.setTextSize(2);
		tft.print(device_params.error_message);
		sprintf(displayed_params.error_message, "%s", device_params.error_message);
	}
	
}

void device_displayRefresh( void )
{
    disp_millis = millis();
}

void device_displayError( char *error )
{
    #ifdef DEVICE_DEBUG
        Serial.println(error);
    #endif
	tft.fillScreen(ST77XX_BLACK);
	tft.setCursor(0, 0);
	tft.setTextColor(ST77XX_RED);
	tft.setTextSize(4);
	tft.println("ERROR!");
	tft.setTextSize(2);
	tft.setTextWrap(true);
	tft.print(error);
	while(1)
	{
		tft.print(".");
		delay(1000);
	}
    
}

/* ----------------------------------- EOF ---------------------------------- */
